## mqtt-iot-client/main/Kconfig.projbuild.example
```kconfig
menu "MQTT BROKER Configuration"

config BROKER_URL
    string "Broker URL"
    default "mqtt://192.168.0.104"
    help
        URL of the broker to connect to

config MQ9_MQTT_TOPIC
    string "MQTT TOPIC"
    default "mq9"

config MQ9_REFRESH_INTERVAL_MS
    int "MQ9 REFRESH INTERVAL MS"
    default 5000

config WIFI_SSID
	string "WiFi SSID"
	default "<WIFI SSID>"
	help
		SSID (network name) for the example to connect to.

config WIFI_PASSWORD
	string "WiFi Password"
	default "<WIFI WPA OR WPA2 PASSWORD>"
	help
		WiFi password (WPA or WPA2) for the example to use.
		Can be left blank if the network has no security set.

endmenu
```
